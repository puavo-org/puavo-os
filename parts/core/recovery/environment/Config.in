## parts/core/recovery/environment/Config.in
```kconfig
source "$BR2_EXTERNAL_PUAVO_RECOVERY_PATH/package/puavo-boot-trust-manager/Config.in"
source "$BR2_EXTERNAL_PUAVO_RECOVERY_PATH/package/efitools/Config.in"
```

## parts/core/recovery/environment/configs/puavo_recovery_defconfig
```kconfig
BR2_x86_64=y
BR2_DL_DIR="$(BR2_EXTERNAL_PUAVO_RECOVERY_PATH)/downloads"
BR2_DOWNLOAD_FORCE_CHECK_HASHES=y
BR2_GLOBAL_PATCH_DIR="$(BR2_EXTERNAL_PUAVO_RECOVERY_PATH)/board/patches"
BR2_TOOLCHAIN_EXTERNAL=y
BR2_TOOLCHAIN_EXTERNAL_BOOTLIN=y
BR2_TOOLCHAIN_EXTERNAL_BOOTLIN_X86_64_GLIBC_STABLE=y
BR2_INIT_SYSTEMD=y
BR2_PACKAGE_SYSTEMD_EFI=y
BR2_PACKAGE_SYSTEMD_LOGIND=y
BR2_PACKAGE_SYSTEMD_VCONSOLE_DEFAULT_KEYMAP="fi"
# BR2_PACKAGE_SYSTEMD_HWDB is not set
# BR2_PACKAGE_SYSTEMD_NETWORKD is not set
# BR2_PACKAGE_SYSTEMD_RESOLVED is not set
# BR2_PACKAGE_SYSTEMD_TIMESYNCD is not set
# BR2_TARGET_GENERIC_GETTY is not set
# BR2_TARGET_ENABLE_ROOT_LOGIN is not set
BR2_ROOTFS_OVERLAY="$(BR2_EXTERNAL_PUAVO_RECOVERY_PATH)/board/overlay $(BR2_EXTERNAL_PUAVO_RECOVERY_PATH)/build/overlay"
BR2_LINUX_KERNEL=y
BR2_LINUX_KERNEL_CUSTOM_VERSION=y
BR2_LINUX_KERNEL_CUSTOM_VERSION_VALUE="6.12.113"
BR2_LINUX_KERNEL_USE_ARCH_DEFAULT_CONFIG=y
BR2_LINUX_KERNEL_CONFIG_FRAGMENT_FILES="$(BR2_EXTERNAL_PUAVO_RECOVERY_PATH)/board/linux.fragment"
BR2_LINUX_KERNEL_BZIMAGE=y
BR2_LINUX_KERNEL_NEEDS_HOST_OPENSSL=y
BR2_LINUX_KERNEL_NEEDS_HOST_LIBELF=y
BR2_PACKAGE_LINUX_FIRMWARE=y
BR2_PACKAGE_LINUX_FIRMWARE_IWLWIFI_3160=y
BR2_PACKAGE_LINUX_FIRMWARE_IWLWIFI_3168=y
BR2_PACKAGE_LINUX_FIRMWARE_IWLWIFI_7260=y
BR2_PACKAGE_LINUX_FIRMWARE_IWLWIFI_7265=y
BR2_PACKAGE_LINUX_FIRMWARE_IWLWIFI_7265D=y
BR2_PACKAGE_LINUX_FIRMWARE_IWLWIFI_8000C=y
BR2_PACKAGE_LINUX_FIRMWARE_IWLWIFI_8265=y
BR2_PACKAGE_LINUX_FIRMWARE_IWLWIFI_9XXX=y
BR2_PACKAGE_LINUX_FIRMWARE_IWLWIFI_22000=y
BR2_PACKAGE_LINUX_FIRMWARE_IWLWIFI_QUZ=y
BR2_PACKAGE_LINUX_FIRMWARE_IWLWIFI_6E=y
BR2_PACKAGE_LINUX_FIRMWARE_IWLWIFI_7=y
BR2_PACKAGE_LINUX_FIRMWARE_RTL_RTW88=y
BR2_PACKAGE_LINUX_FIRMWARE_RTL_RTW89=y
BR2_PACKAGE_LINUX_FIRMWARE_MEDIATEK_MT7921=y
BR2_PACKAGE_LINUX_FIRMWARE_MEDIATEK_MT7922=y
BR2_PACKAGE_LINUX_FIRMWARE_MEDIATEK_MT7925=y
BR2_PACKAGE_LINUX_FIRMWARE_QUALCOMM_6174=y
BR2_PACKAGE_LINUX_FIRMWARE_ATHEROS_10K_QCA9377=y
BR2_PACKAGE_LINUX_FIRMWARE_QUALCOMM_WCN7850=y
BR2_PACKAGE_LINUX_FIRMWARE_RTL_8169=y
BR2_PACKAGE_LINUX_FIRMWARE_RTL_815X=y
BR2_PACKAGE_DBUS=y
BR2_PACKAGE_WIRELESS_REGDB=y
BR2_PACKAGE_KBD=y
BR2_PACKAGE_CRYPTSETUP=y
# BR2_PACKAGE_LVM2_STANDARD_INSTALL is not set
BR2_PACKAGE_TPM2_TSS=y
BR2_PACKAGE_WPA_SUPPLICANT=y
BR2_PACKAGE_WPA_SUPPLICANT_NL80211=y
BR2_PACKAGE_WPA_SUPPLICANT_DBUS=y
BR2_PACKAGE_NETWORK_MANAGER=y
BR2_PACKAGE_PUAVO_BOOT_TRUST_MANAGER=y
BR2_TARGET_ROOTFS_CPIO=y
BR2_TARGET_ROOTFS_CPIO_ZSTD=y
# BR2_TARGET_ROOTFS_TAR is not set
```

## parts/core/recovery/environment/package/efitools/Config.in
```kconfig
config BR2_PACKAGE_EFITOOLS
	bool "efitools"
	depends on BR2_PACKAGE_GNU_EFI_ARCH_SUPPORTS
	select BR2_PACKAGE_GNU_EFI
	select BR2_PACKAGE_OPENSSL
	select BR2_PACKAGE_LIBOPENSSL_ENGINES # signing goes through the engine interface
	help
	  The programs of efitools that make, sign and write UEFI
	  signature lists.

	  https://git.kernel.org/pub/scm/linux/kernel/git/jejb/efitools.git
```

## parts/core/recovery/environment/package/puavo-boot-trust-manager/Config.in
```kconfig
config BR2_PACKAGE_PUAVO_BOOT_TRUST_MANAGER
	bool "puavo-boot-trust-manager"
	depends on BR2_PACKAGE_SYSTEMD
	select BR2_PACKAGE_CRYPTSETUP
	select BR2_PACKAGE_EFITOOLS
	select BR2_PACKAGE_TPM2_TOOLS
	select BR2_PACKAGE_TPM2_TSS
	help
	  The boot trust manager of the images, with their enrollments
	  and the scripts it runs to reset the device keys and the TPM,
	  for the recovery of the disk encryption.
```
